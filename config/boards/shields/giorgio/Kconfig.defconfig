## config/boards/shields/giorgio/Kconfig.defconfig
```kconfig
if SHIELD_GIORGIO_LEFT
config ZMK_KEYBOARD_NAME
    default "Giorgio 100"

config ZMK_SPLIT_ROLE_CENTRAL
    default y
endif

if SHIELD_GIORGIO_LEFT || SHIELD_GIORGIO_RIGHT
config ZMK_SPLIT
    default y
endif
```

## config/boards/shields/giorgio/Kconfig.shield
```kconfig
condig SHIELD_GIORGIO_LEFT
    def_bool $(shields_list_contains,giorgio_left)

config SHIELD_GIORGIO_RIGHT
    def_bool $(shields_list_contains,giorgio_right)
```
