#include "giorgio.dtsi"

&default_transform {
    col-offset = <6>;
    row-offset = <4>;
};

&kscan0 {
    col-gpios
        = <&gpio0  3 GPIO_ACTIVE_HIGH>
        , <&gpio0 28 GPIO_ACTIVE_HIGH>
        , <&gpio0 29 GPIO_ACTIVE_HIGH>
        , <&gpio0  4 GPIO_ACTIVE_HIGH>
        , <&gpio0  5 GPIO_ACTIVE_HIGH>
        , <&gpio1 11 GPIO_ACTIVE_HIGH>
        ;

    row-gpios
        = <&gpio0  2 (GPIO_ACTIVE_HIGH | GPIO_PULL_DOWN)>
        , <&gpio1 15 (GPIO_ACTIVE_HIGH | GPIO_PULL_DOWN)>
        , <&gpio1 14 (GPIO_ACTIVE_HIGH | GPIO_PULL_DOWN)>
        , <&gpio1 13 (GPIO_ACTIVE_HIGH | GPIO_PULL_DOWN)>
        ;
};

&right_encoder {
    status = "okay";
};
